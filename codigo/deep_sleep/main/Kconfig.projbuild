## codigo/deep_sleep/main/Kconfig.projbuild
```kconfig
menu "Example Configuration"

    config EXAMPLE_TOUCH_WAKEUP
        bool "Enable touch wake up"
        default y
        depends on SOC_PM_SUPPORT_TOUCH_SENSOR_WAKEUP
        help
            This option enables wake up from deep sleep using touch pads
            TOUCH8 and TOUCH9, which correspond to GPIO33 and GPIO32.

    config EXAMPLE_EXT0_WAKEUP
        bool "Enable wakeup from GPIO (ext0)"
        default y
        depends on !SOC_GPIO_SUPPORT_DEEPSLEEP_WAKEUP
        help
            This option enables wake up from deep sleep from GPIO3. They should be connected to LOW to avoid
            floating pins. When triggering a wake up, connect one or both of the pins to HIGH. Note that floating
            pins may trigger a wake up.

    config EXAMPLE_EXT1_WAKEUP
        bool "Enable wakeup from GPIO (ext1)"
        default y
        depends on !SOC_GPIO_SUPPORT_DEEPSLEEP_WAKEUP
        help
            This option enables wake up from deep sleep from GPIO2 and GPIO4. They should be connected to LOW to avoid
            floating pins. When triggering a wake up, connect one or both of the pins to HIGH. Note that floating
            pins may trigger a wake up.

    config EXAMPLE_EXT1_USE_INTERNAL_PULLUPS
        bool "Use internal pull-up/downs for EXT1 wakeup source"
        default n
        depends on EXAMPLE_EXT1_WAKEUP
        help
            When using EXT1 wakeup source without external pull-up/downs, you may want to make use of the internal
            ones.

            However, the RTC IO reside in the RTC Periph power domain. Enable this option to force that power domain
            ON during deep sleep. Note that this will increase some power comsumption, so it's still suggested to use
            external ones instead.

            EXT0 wakeup source resides in the same power domain as RTCIO (RTC Periph), so internal pull-up/downs are
            always available. There's no need to explicitly force it on for EXT0.

    config EXAMPLE_GPIO_WAKEUP
        bool "Enable wakeup from GPIO"
        default y
        depends on SOC_GPIO_SUPPORT_DEEPSLEEP_WAKEUP
        help
            This option enables wake up from GPIO. Be aware that if you use low level to trigger wakeup, we strongly
            recommand you to connect external pull-up resistance.
       
    config NUM_OF_DATA
        int "Number of data measurements"
        default 20
        help
            Set the number of data measurements to store before uploading it to thingsboard

    config I2C_MASTER_SCL
        int "SCL GPIO Num"
        default 6 if IDF_TARGET_ESP32C3
        default 22 if IDF_TARGET_ESP32 || IDF_TARGET_ESP32S2 || IDF_TARGET_ESP32S3
        help
            GPIO number for I2C Master clock line.

    config I2C_MASTER_SDA
        int "SDA GPIO Num"
        default 5 if IDF_TARGET_ESP32C3
        default 21 if IDF_TARGET_ESP32 || IDF_TARGET_ESP32S2 || IDF_TARGET_ESP32S3
        help
            GPIO number for I2C Master data line.

    menu "GPIO wakeup configuration"
        visible if SOC_GPIO_SUPPORT_DEEPSLEEP_WAKEUP

        config EXAMPLE_GPIO_WAKEUP_PIN
            int "Enable wakeup from GPIO"
            default 0 if !IDF_TARGET_ESP32H2_BETA_VERSION_2
            default 7 if IDF_TARGET_ESP32H2_BETA_VERSION_2
            range 0 5 if !IDF_TARGET_ESP32H2_BETA_VERSION_2
            range 7 12 if IDF_TARGET_ESP32H2_BETA_VERSION_2

        config EXAMPLE_GPIO_WAKEUP_HIGH_LEVEL
            bool "Enable GPIO high-level wakeup"
            default y
            help
                This option set the gpio wake-up trigger signal, In deep sleep, only high or low level wake-up is
                supported. If this option is enabled, it is a high level wake up, otherwise it is a low level wake up.
    endmenu
    
    menu "Wifi Configuration"
        config ESP_WIFI_SSID
            string "WiFi SSID"
            default "myssid"
            help
                SSID (network name) for the example to connect to.
    
        config ESP_WIFI_PASSWORD
            string "WiFi Password"
            default "mypassword"
            help
                WiFi password (WPA or WPA2) for the example to use.
        
        config ESP_MAXIMUM_RETRY
            int "Maximum retry"
            default 3
            help
                Set the Maximum retry to avoid station reconnecting to the AP unlimited when the AP is really inexistent.
    
        choice ESP_WIFI_SCAN_AUTH_MODE_THRESHOLD
            prompt "WiFi Scan auth mode threshold"
            default ESP_WIFI_AUTH_OPEN
            help
                The weakest authmode to accept in the scan mode.
    
            config ESP_WIFI_AUTH_OPEN
                bool "OPEN"
            config ESP_WIFI_AUTH_WEP
                bool "WEP"
            config ESP_WIFI_AUTH_WPA_PSK
                bool "WPA PSK"
            config ESP_WIFI_AUTH_WPA2_PSK
                bool "WPA2 PSK"
            config ESP_WIFI_AUTH_WPA_WPA2_PSK
                bool "WPA/WPA2 PSK"
            config ESP_WIFI_AUTH_WPA3_PSK
                bool "WPA3 PSK"
            config ESP_WIFI_AUTH_WPA2_WPA3_PSK
                bool "WPA2/WPA3 PSK"
            config ESP_WIFI_AUTH_WAPI_PSK
                bool "WAPI PSK"
        endchoice
    endmenu

    menu "Thingsboard Configuration"
        config THINGSBOARD_MQTT_URI
            string "Thingsboard mqtt client uri"
            default "mqtt://demo.thingsboard.io:1883"
            help
                The uri to the thingsboard MQTT client 
    
        config THINGSBOARD_MQTT_USERNAME
            string "Thingsboard username"
            default "UVbEFDn8v4GKb3gMwAkK"
            help
                username.
                
        config THINGSBOARD_MQTT_CLIENT_ID
            string "Thingsboard client ID"
            default "0cb8c690-d6666-11ed-b75c-7d8052ad39cf"
            help
                The thingsboard device ID.

        config THINGSBOARD_MQTT_PORT
            int "MQTT port"
            default 1883
    endmenu

    menu "SNTP configuration"
        config SNTP_TIME_SERVER
            string "SNTP server to get the time from"
            default "es.pool.ntp.org"
            help
                This is the server that will be used to set the current time.
    endmenu

    menu "OTA Configuration"

        config EXAMPLE_FIRMWARE_UPGRADE_URL
            string "firmware upgrade url endpoint"
            default "https://192.168.0.3:8070/hello_world.bin"
            help
                URL of server which hosts the firmware
                image.
    
        config EXAMPLE_FIRMWARE_UPGRADE_URL_FROM_STDIN
            bool
            default y if EXAMPLE_FIRMWARE_UPGRADE_URL = "FROM_STDIN"
    
        config EXAMPLE_SKIP_COMMON_NAME_CHECK
            bool "Skip server certificate CN fieldcheck"
            default n
            help
                This allows you to skip the validation of OTA server certificate CN field.
    
        config EXAMPLE_FIRMWARE_UPGRADE_BIND_IF
            bool "Support firmware upgrade bind specified interface"
            default n
            help
                This allows you to bind specified interface in OTA example.
    
        choice EXAMPLE_FIRMWARE_UPGRADE_BIND_IF_TYPE
            prompt "Choose OTA data bind interface"
            default EXAMPLE_FIRMWARE_UPGRADE_BIND_IF_STA
            depends on EXAMPLE_FIRMWARE_UPGRADE_BIND_IF
            help
                Select which interface type of OTA data go through.
    
            config EXAMPLE_FIRMWARE_UPGRADE_BIND_IF_STA
                bool "Bind wifi station interface"
                depends on EXAMPLE_CONNECT_WIFI
                help
                    Select wifi station interface to pass the OTA data.
    
            config EXAMPLE_FIRMWARE_UPGRADE_BIND_IF_ETH
                bool "Bind ethernet interface"
                depends on EXAMPLE_CONNECT_ETHERNET
                help
                    Select ethernet interface to pass the OTA data.
        endchoice
    endmenu
    

endmenu
```
